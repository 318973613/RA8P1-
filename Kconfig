## Kconfig
```kconfig
mainmenu "RT-Thread Configuration"

BSP_DIR := .

RTT_DIR := rt-thread

# you can change the RTT_ROOT default "../.." to your rtthread_root,
# example : default "F:/git_repositories/rt-thread"

PKGS_DIR := packages

ENV_DIR := /

config PLATFORM_DIR
    string
    option env="PLATFORM_DIR"
    default "D:/RT-ThreadStudio/workspace/wfi_board/platform"

config RTT_DIR
    string
    option env="RTT_DIR"
    default "D:/RT-ThreadStudio/workspace/wfi_board/rt-thread"

config PKGS_DIR
    string
    option env="PKGS_DIR"
    default "D:/RT-ThreadStudio2.3.0/platform/env_released/env/packages"

source "$(RTT_DIR)/Kconfig"
source "$PKGS_DIR/Kconfig"
source "libraries/Kconfig"
source "$(BSP_DIR)/board/Kconfig"
```
